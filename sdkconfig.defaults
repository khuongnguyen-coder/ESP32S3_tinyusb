## sdkconfig.defaults
```kconfig
CONFIG_TINYUSB_VENDOR_COUNT=1
CONFIG_TINYUSB_VENDOR_RX_BUFSIZE=64
CONFIG_TINYUSB_VENDOR_TX_BUFSIZE=64
CONFIG_TINYUSB_VENDOR_EPSIZE=64
CONFIG_TINYUSB_DESC_USE_ESPRESSIF_VID=n
CONFIG_TINYUSB_DESC_USE_DEFAULT_PID=n
CONFIG_TINYUSB_DESC_CUSTOM_VID=0x1505
CONFIG_TINYUSB_DESC_CUSTOM_PID=0x1991
```
